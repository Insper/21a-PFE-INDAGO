/**
 * @cliArgs --board "/ti/boards/CC1352P1_LAUNCHXL" --product "simplelink_cc13x2_26x2_sdk@4.40.04.04"
 * @versions {"data":"2021010520","timestamp":"2021010520","tool":"1.7.0+1746","templates":null}
 */

/**
 * Import the modules used in this configuration.
 */
const GPIO   = scripting.addModule("/ti/drivers/GPIO");
const GPIO1  = GPIO.addInstance();
const GPIO2  = GPIO.addInstance();
const RTOS   = scripting.addModule("/ti/drivers/RTOS");
const Timer  = scripting.addModule("/ti/drivers/Timer", {}, false);
const Timer1 = Timer.addInstance();
const UART   = scripting.addModule("/ti/drivers/UART", {}, false);
const UART1  = UART.addInstance();

/**
 * Write custom configuration values to the imported modules.
 */
GPIO1.$name             = "DIGITAL_RX";
GPIO1.pull              = "Pull Down";
GPIO1.interruptTrigger  = "Both Edges";
GPIO1.gpioPin.$assign   = "boosterpack.23";
GPIO1.pinInstance.$name = "CONFIG_PIN_1";

GPIO2.$name             = "DIGITAL_TX";
GPIO2.mode              = "Output";
GPIO2.pinInstance.$name = "CONFIG_PIN_2";

const CCFG              = scripting.addModule("/ti/devices/CCFG", {}, false);
CCFG.ccfgTemplate.$name = "ti_devices_CCFGTemplate0";

Timer1.$name               = "CONFIG_TIMER_0";
Timer1.timerInstance.$name = "CONFIG_GPTIMER_0";

UART1.$name               = "CONFIG_UART_0";
UART1.$hardware           = system.deviceData.board.components.XDS110UART;
UART1.txPinInstance.$name = "CONFIG_PIN_1_";
UART1.rxPinInstance.$name = "CONFIG_PIN_2_";

/**
 * Pinmux solution for unlocked pins/peripherals. This ensures that minor changes to the automatic solver in a future
 * version of the tool will not impact the pinmux you originally saw.  These lines can be completely deleted in order to
 * re-solve from scratch.
 */
GPIO2.gpioPin.$suggestSolution              = "boosterpack.10";
Timer1.timerInstance.timer.$suggestSolution = "GPTM0";
UART1.uart.$suggestSolution                 = "UART0";
UART1.uart.txPin.$suggestSolution           = "boosterpack.4";
UART1.uart.rxPin.$suggestSolution           = "boosterpack.3";
